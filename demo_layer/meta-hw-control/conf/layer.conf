## demo_layer/meta-hw-control/conf/layer.conf
```bitbake
# We have a conf and classes directory, add to BBPATH
BBPATH .= ":${LAYERDIR}"

# We have recipes-* directories, add to BBFILES
BBFILES += "${LAYERDIR}/recipes-*/*/*.bb \
            ${LAYERDIR}/recipes-*/*/*.bbappend"

BBFILE_COLLECTIONS += "meta-hw-control"
BBFILE_PATTERN_meta-hw-control = "^${LAYERDIR}/"
BBFILE_PRIORITY_meta-hw-control = "8"

LAYERDEPENDS_meta-hw-control = "core"
LAYERSERIES_COMPAT_meta-hw-control = "kirkstone"
```
